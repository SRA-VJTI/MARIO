## esp32_codes/components/ros_sra20/Kconfig
```kconfig
menu "servo configuration"
    # set pin numbers 
    # set servo min max pulse

config MICRO_SERVO_MIN_PULSEWIDTH
    int "micro servo minimum pulsewidth"
    default 500
    help
        sets the micro servo minimum pulsewidth

config MICRO_SERVO_MAX_PULSEWIDTH
    int "micro servo max pulsewidth"
    default 2400
    help
        sets the micro servo maximum pulsewidth

config SERVO_MIN_PULSEWIDTH
    int "servo minimum pulsewidth"
    default 500
    help 
        sets the servo minimum pulsewidth

config SERVO_MAX_PULSEWIDTH
    int "servo maximum pulsewidth"
    default 3000
    help 
        sets the servo maximum pulsewidth

config SERVO_MAX_DEGREE
    int "servo max degree"
    default 180
    help 
        sets the servo max degree

config SERVO_BASE
    int "base servo pin number"
    default 18
    help 
        sets the gpio for base servo

config SERVO_SHOULDER
    int "shoulder servo pin number"
    default 19
    help 
        sets the gpio for shoulder servo

config SERVO_ELBOW
    int "elbow servo pin number"
    default 21
    help 
        sets the gpio for elbow servo

endmenu
```

## firmware/4_microros_gazebo_mujoco/main/Kconfig.projbuild
```kconfig
# put here your custom config value
menu "Example Configuration"
config ESP_WIFI_SSID
    string "WiFi SSID"
    default "myssid"
    help
	SSID (network name) for the example to connect to.

config ESP_WIFI_PASSWORD
    string "WiFi Password"
    default "mypassword"
    help
	WiFi password (WPA or WPA2) for the example to use.
endmenu
menu "micro-ROS example-app settings"

    config MICRO_ROS_APP_STACK
        int "Stack the micro-ROS app (Bytes)"
        default 5000
        help
        Stack size in Bytes of the micro-ROS app

    config MICRO_ROS_APP_TASK_PRIO
        int "Priority of the micro-ROS app"
        default 5
        help
        Priority of micro-ros task higher value means higher priority

endmenu
```

## firmware/components/rosserial_esp32/Kconfig
```kconfig
menu "MARIO-Rosserial"

config ROSSERIAL_OVER_WIFI
    bool "rosserial over WiFi using TCP"
    default n
    help
        Use rosserial over WiFi using TCP

config ROSSERVER_AP
    string "WiFi SSID"
    default "myssid"
    depends on ROSSERIAL_OVER_WIFI
    help
        SSID (Access point name) of WiFi to connect

config ROSSERVER_PASS
    string "WiFi Password"
    default "mypass"
    depends on ROSSERIAL_OVER_WIFI
    help
        Password of the WiFi

config ROSSERVER_IP
    string "IP address of ROS server (roscore)"
    default "192.168.0.1"
    depends on ROSSERIAL_OVER_WIFI
    help
        IP address of machine which is running rosserial server

config ROSSERVER_PORT
    int "Port number of ROS server"
    default 11411
    depends on ROSSERIAL_OVER_WIFI
    help
        Port number of rosserial server

        Port number is printed on terminal running rosserial_python

endmenu
```
